## conf/layer.conf
```bitbake
# We have a conf and classes directory, add to BBPATH
BBPATH .= ":${LAYERDIR}"

# We have recipes-* directories, add to BBFILES
BBFILES += "${LAYERDIR}/recipes-*/*/*.bb \
            ${LAYERDIR}/recipes-*/*/*.bbappend"

BBFILE_COLLECTIONS += "meta-norik-memfault"
BBFILE_PATTERN_meta-norik-memfault = "^${LAYERDIR}/"
BBFILE_PRIORITY_meta-norik-memfault = "30"

LAYERDEPENDS_meta-norik-memfault = "core swupdate"
LAYERSERIES_COMPAT_meta-norik-memfault = "kirkstone"
```

## conf/machine/phyboard-polis-imx8mm-4-memfault.conf
```bitbake
# Override the BSP defaults
WKS_FILES:mx8m-nxp-bsp = "swupdate-sdimage.wks"
WKS_FILES:mx8m-mainline-bsp = "swupdate-sdimage.wks"
# 1 = SD card, 2 = eMMC
EMMC_DEV:mx8mm-generic-bsp = "1"

OTA_PARTITION_A = "mmcblk${EMMC_DEV}p2"
OTA_PARTITION_B = "mmcblk${EMMC_DEV}p3"
```

## wic/swupdate-sdimage.wks
```
part u-boot --source rawcopy --sourceparams="file=imx-boot" --ondisk mmc --no-table --align ${BOOTLOADER_SEEK}
# Copy the u-boot environment to the predefined offset 0x3e0000
part u-boot-env --source rawcopy --sourceparams="file=u-boot-env.bin" --ondisk mmc --no-table --offset 7936s --fixed-size 64k

part --source bootimg-partition --fstype=vfat --label boot --ondisk mmc --active --align 4096 --size ${WKS_BOOTIMAGESIZE}
part / --source rootfs --fstype=ext4 --label root_a --ondisk mmc --use-uuid
part / --source rootfs --fstype=ext4 --label root_b --ondisk mmc --use-uuid
part /data --fstype=ext4 --label data --ondisk mmc --fixed-size 64

bootloader --timeout=0
```
